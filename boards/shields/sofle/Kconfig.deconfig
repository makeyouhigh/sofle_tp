## boards/shields/sofle/Kconfig.deconfig
```kconfig
#
# Copyright (c) 2024 The ZMK Contributors
# SPDX-License-Identifier: MIT
#

if SHIELD_TP_SOFLE_RIGHT

config ZMK_KEYBOARD_NAME
    default "TP Sofle"

config ZMK_SPLIT_ROLE_CENTRAL
    default y

endif # SHIELD_SOFLE_LEFT TO RIGHT

if SHIELD_TP_SOFLE_LEFT || TP_SHIELD_SOFLE_RIGHT

config ZMK_SPLIT
    default y

if ZMK_DISPLAY

config I2C
    default y

config SSD1306
    default n

choice ZMK_DISPLAY_WORK_QUEUE
    default ZMK_DISPLAY_WORK_QUEUE_DEDICATED
endchoice

endif

if SSD1306

config LV_Z_VDB_SIZE
    default 64

config LV_DPI_DEF
    default 148

config LV_Z_BITS_PER_PIXEL
    default 1

choice LV_COLOR_DEPTH
    default LV_COLOR_DEPTH_1
endchoice

endif

if ZMK_BACKLIGHT

config PWM
    default y

config LED_PWM
    default y

endif # ZMK_BACKLIGHT

endif # SHIELD_TP_SOFLE_LEFT || SHIELD_TP_SOFLE_RIGHT
```

## boards/shields/sofle/Kconfig.shield
```kconfig
#
# Copyright (c) 2024 The ZMK Contributors
# SPDX-License-Identifier: MIT
#

config SHIELD_TP_SOFLE_LEFT
    def_bool $(shields_list_contains,tp_sofle_left)

config SHIELD_TP_SOFLE_RIGHT
    def_bool $(shields_list_contains,tp_sofle_right)
```

## config/west.yml
```yaml
manifest:
  remotes:
    - name: zmkfirmware
      url-base: https://github.com/zmkfirmware
    # Additional modules containing boards/shields/custom code can be listed here as well
    # See https://docs.zephyrproject.org/3.2.0/develop/west/manifest.html#projects
    - name: gpeye
      url-base: https://github.com/GPeye
    - name: m165437
      url-base: https://github.com/M165437
    - name: infused-kim
      url-base: https://github.com/infused-kim
    - name: tokyo2006
      url-base: https://github.com/tokyo2006
  projects:
    - name: zmk
      remote: zmkfirmware
      revision: v0.3.0
#      remote: infused-kim
#      revision: pr-testing/mouse_ps2_module_base
      import: app/west.yml
    - name: mario-peripheral-animation
      remote: gpeye
      revision: main 
    - name: nice-view-gem
      remote: m165437
      revision: main 
    - name: prospector-zmk-module                 # <--- and these
      remote: tokyo2006                          # <---
      revision: micro_spi2  
    # zmk module for PS/2 mouse / TP driver
    - name: kb_zmk_ps2_mouse_trackpoint_driver
      remote: infused-kim
      revision: main
     
  self:
    path: config
```
